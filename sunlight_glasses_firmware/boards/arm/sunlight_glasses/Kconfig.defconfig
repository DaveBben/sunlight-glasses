## sunlight_glasses_firmware/boards/arm/sunlight_glasses/Kconfig.defconfig
```kconfig
# Copyright (c) 2024 Nordic Semiconductor ASA
# SPDX-License-Identifier: Apache-2.0

if BOARD_SUNLIGHT_GLASSES

config BOARD
	default "sunlight_glasses"

config BT_CTLR
   default BT


endif
```
